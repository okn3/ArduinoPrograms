
#define DUTY 10     // DUTYlP`QOlBlkdc_
#define S_DELAY 80  // S_DELAYlXN[
#define DOTS 54

boolean matrix[8][DOTS+1]={
//      o               k                u               N             0            .
{0, 0,1,1,1,0, 0,0 ,1,0,0,0,1,  0,0, 1,0,0,0,1 ,0,0, 1,0,0,0,1, 0,0, 0,1,1,1,0, 0,0, 0,0 },
{0, 1,0,0,0,1, 0,0 ,1,0,0,1,0,  0,0, 1,0,0,0,1, 0,0, 1,0,0,0,1, 0,0, 1,0,0,0,1, 0,0, 0,0 },
{0, 1,0,0,0,1, 0,0 ,1,0,1,1,0,  0,0, 1,0,0,0,1, 0,0, 1,1,0,0,1, 0,0, 1,0,0,0,1, 0,0, 0,0 },
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{0, 0,1,1,1,0, 0,0 ,1,0,0,0,1,  0,0, 0,1,1,1,0, 0,0, 1,0,0,0,1, 0,0, 0,1,1,1,0, 0,0, 0,0 },
};

//
void setup(){
  for(int i=2;i<=17;i++){
    pinMode(i,OUTPUT);
    digitalWrite(i,LOW);
  }
}

//kdc}gNXszu@14=A0,15=A1,16=A2,17=A3
byte col[8]={ 5,11,10, 8,16, 7, 3, 2};
byte row[8]={ 9, 4,14, 6,13,15,12,17};

void loop(){
  int count=S_DELAY;
  while(count>0){
   for(int r=0;r<=7;r++){
    digitalWrite(row[r],HIGH);  //row sFHIGH_  
    for(int c=0;c<=7;c++){
      digitalWrite(col[c],!matrix[r][c+1]);   //col FLOW_
      delayMicroseconds(DUTY);//_
      digitalWrite(col[c],HIGH);//It 
      delayMicroseconds(21-DUTY);
     }
      digitalWrite(row[r],LOW);//It
    }
    count--;
  }

  //JXP[fBO
  for(int k=0;k<=7;k++){
    for(int l=0;l<=DOTS;l++){
      if(l==DOTS){
        matrix[k][DOTS]=matrix[k][0];
      }else{
        matrix[k][l]=matrix[k][l+1];
      }
    }
  }
}
